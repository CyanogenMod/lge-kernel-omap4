## drivers/net/wireless/bcm4330_b2/Kconfig
```kconfig
config BCM4330_B2
	tristate "Broadcom BCM4330 REV B2 wireless support"
	select WIRELESS_EXT
	---help---
	  This is a driver for the Broadcom BCM4330 REV B2 wireless chip.

config BCM4330_DEBUG
	bool "Debug"
	default n
	depends on BCM4330_B2

config LGE_BCM432X_PATCH
	bool "BCM432X Patch by LGE"
	default y
	depends on BCM4330_B2

config BCM4330_GPIO_WL_RESET
	int "GPIO WL_RESET"
	default 158
	depends on BCM4330_B2

config BRCM_LGE_WL_HOSTWAKEUP
	bool "Support BCM4325/BCM4329/BCM4330 Host Wakeup function"
	default y
	depends on BCM4330_B2

config BRCM_LGE_WL_HOSTWAKEUP_IOCTL
	bool "Use Host Wakeup ioctl function"
	default n
	depends on BCM4330_B2

config BRCM_LGE_WL_PKTFILTER
	bool "Setting Multicat/Broadcast packet fillter."
	default n
	depends on BCM4330_B2

config BRCM_LGE_WL_ARPOFFLOAD
	bool "Use Arp offload function."
	default n
	depends on BCM4330_B2

config BRCM_GPIO_INTR
	bool "Use Broadcom Host Wakeup GPIO"
	default n
	depends on BCM4330_B2
	---help---
	   This function is activated only if set CONFIG_HAS_EARLYSUSPEND.	

config BCM4330_GPIO_WL_HOSTWAKEUP
	int "GPIO WL_HOSTWAKEUP"
	default 167
	depends on BCM4330_B2

config BRCM_USE_DEEPSLEEP
	bool "Use deepsleep instead of dhd_dev_reset"
	default n
	depends on BCM4330_B2
	---help---
	  Use deepsleep instead of dhd_dev_reset and controlling GPIO when driver start or stop.

config BRCM_USE_SOFTAP
	bool "Use SoftAP"
	default n
	depends on BCM4330_B2
	---help---
	Using Softap feature.

config BRCM_USE_STATIC_BUF
	bool "Use static buff of osl_malloc"
	default n
	depends on BCM4330_B2

#LGE_CHANGE_S, 2011-0226, add CCX
config BCM43xx_CCX
    bool "Enable CCX feature"
    default n
    depends on BCM4330_B2
    ---help---
        Enabling/disabling CCX features
#LGE_CHANGE_E, 2011-0226, add CCX

config BRCM_USE_WLP2P
	bool "Use P2P"
	default n
	depends on BCM4330_B2
	---help---
	Using P2P feature.

config BRCM_USE_WLBTAMP
	bool "Use BTAMP"
	default n
	depends on BCM4330_B2
	---help---
	Using BTAMP feature.
```

## drivers/net/wireless/bcmdhd/Kconfig
```kconfig
config BCMDHD
	tristate "Broadcom 4329/30 wireless cards support"
	depends on MMC
	---help---
	  This module adds support for wireless adapters based on
	  Broadcom 4329/30 chipset.

	  This driver uses the kernel's wireless extensions subsystem.

	  If you choose to build a module, it'll be called dhd. Say M if
	  unsure.

config BCMDHD_FW_PATH
	depends on BCMDHD
	string "Firmware path"
	default "/system/etc/firmware/fw_bcmdhd.bin"
	---help---
	  Path to the firmware file.

config BCMDHD_NVRAM_PATH
	depends on BCMDHD
	string "NVRAM path"
	default "/system/etc/wifi/bcmdhd.cal"
	---help---
	  Path to the calibration file.

config BCMDHD_WEXT
	bool "Enable WEXT support"
	depends on BCMDHD && CFG80211 = n
	select WIRELESS_EXT
	select WEXT_PRIV
	---help---
	  Enables WEXT support

config LGE_BCM432X_PATCH
	bool "BCM432X Patch by LGE"
	default y
	depends on BCMDHD

config BCMDHD_CONFIG_PATH
	depends on LGE_BCM432X_PATCH
	string "Config path"
	default "/data/misc/wifi/config"
	---help---
	  Path to the config file.

config BCMDHD_GPIO_WL_RESET
	depends on BCMDHD
	int "GPIO to the Reset"
	default 168 if(MACH_LGE_P2_LU5400!=y)
        default 95 if(MACH_LGE_P2_LU5400=y)
	---help---
	  GPIO to the Reset

config BCMDHD_HOSTWAKEUP_USE_GPIO
	depends on BCMDHD
	bool "Use GPIO to Host Wakeup"
	select BCMDHD_HW_OOB
	default y
	---help---
	  Use GPIO to Host Wakeup

config BCMDHD_HOSTWAKEUP_USE_SDIO
	depends on BCMDHD && BCMDHD_HOSTWAKEUP_USE_GPIO = n
	bool "Use SDIO pin to the Host Wakeup"
	default n
	---help---
	  Use SDIO pin to the Host Wakeup

config BCMDHD_GPIO_WL_HOSTWAKEUP
	depends on BCMDHD && BCMDHD_HOSTWAKEUP_USE_GPIO = y
	int "GPIO to the Host Wakeup"
	default 167 if(MACH_LGE_P2_LU5400!=y)
        default 94 if(MACH_LGE_P2_LU5400=y)
	---help---
	  GPIO to the Host Wakeup

config BCMDHD_HW_OOB
	depends on BCMDHD && BCMDHD_HOSTWAKEUP_USE_GPIO = y
	bool "Use H/W OOB to the Host Wakeup"
	default y
	---help---
	  Use H/W OOB to the Host Wakeup

config BCMDHD_USE_STATIC_BUF
	depends on BCMDHD
	bool "Use static buffer in os_malloc"
	default y
	---help---
	  Use static buffer in os_malloc

config BRCM_CCX
         depends on BCMDHD
         bool "Enables CCX support"
         default n
         ---help---
           Enables CCX support
```

## drivers/video/omap2/displays/Kconfig
```kconfig
menu "OMAP2/3 Display Device Drivers"
        depends on OMAP2_DSS

config PANEL_GENERIC_DPI
        tristate "Generic DPI Panel"
	depends on OMAP2_DSS_DPI
        help
	  Generic DPI panel driver.
	  Supports DVI output for Beagle and OMAP3 SDP.
	  Supports LCD Panel used in TI SDP3430 and EVM boards,
	  OMAP3517 EVM boards and CM-T35.

config PANEL_LGPHILIPS_LB035Q02
	tristate "LG.Philips LB035Q02 LCD Panel"
	depends on OMAP2_DSS_DPI && SPI
	help
	  LCD Panel used on the Gumstix Overo Palo35

config PANEL_SHARP_LS037V7DW01
        tristate "Sharp LS037V7DW01 LCD Panel"
        depends on OMAP2_DSS_DPI
        select BACKLIGHT_CLASS_DEVICE
        help
          LCD Panel used in TI's SDP3430 and EVM boards

config PANEL_NEC_NL8048HL11_01B
	tristate "NEC NL8048HL11-01B Panel"
	depends on OMAP2_DSS_DPI
	help
		This NEC NL8048HL11-01B panel is TFT LCD
		used in the Zoom2/3/3630 sdp boards.

config PANEL_TAAL
        tristate "Taal DSI Panel"
        depends on OMAP2_DSS_DSI
        help
          Taal DSI command mode panel from TPO.

config PANEL_TPO_TD043MTEA1
        tristate "TPO TD043MTEA1 LCD Panel"
        depends on OMAP2_DSS_DPI && SPI
        help
          LCD Panel used in OMAP3 Pandora

config PANEL_ACX565AKM
	tristate "ACX565AKM Panel"
	depends on OMAP2_DSS_SDI && SPI
	select BACKLIGHT_CLASS_DEVICE
	help
	  This is the LCD panel used on Nokia N900

config PANEL_TC358765
	tristate "Toshiba TC358765 DSI-2-LVDS chip"
	depends on OMAP2_DSS_DSI && I2C
	select BACKLIGHT_CLASS_DEVICE
	help
	  Toshiba TC358765 DSI-2-LVDS chip with 1024x768 panel

config TC358765_DEBUG
    bool "Toshiba TC358765 DSI-2-LVDS chip debug"
    depends on PANEL_TC358765 && DEBUG_FS
    help
      Support of TC358765 DSI-2-LVDS chip register access via debugfs

## LGE_SJIT_S 2011-08-29 [choongryeol.lee@lge.com]
config PANEL_LGHDK
       tristate "OMAP4 HDK LCD Panel"
       help
	  LCD Panel used for LGE HDK board 

config PANEL_LH430WV4_SD02
    tristate "B2 Rev.A panel(LH430WV4-SD02) LG4574 driver IC"
    default n
    help
        This is the B2 Rev.A panel(LH430WV4-SD02) LG4574 driver IC

config PANEL_LH430WV2_SD01
    tristate "B2 Rev.A panel(LH430WV2-SD01) LG4573 driver IC"
    default n
    help
        This is the B2 Rev.A panel(LH430WV2-SD01) LG4573 driver IC

config PANEL_TX11D101VM_0EAA
    tristate "B2 Korea and Docomo panel(TX11D101VM_0EAA) LG4574 driver IC"
    default n
    help
        This is the B2 Korea and Docomo HITACHI panel(TX11D101VM_0EAA) LG4574 driver IC

config PANEL_TX11D108VM_0BAA
    tristate "U2-P769 Hitachi panel(TX11D108VM_0BAA) Renesas driver IC"
    default n
    help
        This is the U2-P769 TMUS HITACHI panel(TX11D108VM_0BAA) Renesas driver IC

config PANEL_HX8389
    tristate "U2-P760 Tovis panel() HIMAX driver IC"
    default n
    help
        This is the U2-P760 EU Tovis panel() HIMAX driver IC
choice
    prompt "Choose DSI Mode"
    depends on PANEL_TX11D101VM_0EAA || PANEL_LH430WV4_SD02 || PANEL_TX11D108VM_0BAA || PANEL_HX8389 || PANEL_LH430WV2_SD01
    default DSI_VIDEO_MODE

config DSI_CMD_MODE
    bool "DSI Command Mode"

config DSI_VIDEO_MODE
    bool "DSI Video Mode"

endchoice

config OMAP_USE_CMOS_TE_TRIGGER
    bool "OMAP DSI Tearing Effect Trigger Source is CMOS TE"
    depends on DSI_CMD_MODE
    default y
    help
      OMAP has two trigger source of tearing effect which are DSI PHY and 
      CMOS TE. The CMOS TE is can work without DSI bus turn around(BTA).  
      This configuration can be used when TE trigger source is CMOS TE

config DSI_VIDEO_CMD_TRANSITION
    bool "Workaround for command mode when bootloader use video mode "
    depends on DSI_CMD_MODE && MACH_LGE_P2
    default y
    help
      Since P2 bootloader use video mode, we cannot use command mode with seamless 
      logo display at kernel. So this is workaround to solve this problem.
      Until fisrt suspend, lcd run as video mode and after first suspend lcd rus as command mode. 
   
config PANEL_DX11D100VM
    tristate "Hitachi DX11D100VM LCD panel (Renesas R69328 Driver IC)"
    default n
    help
        This is the Hitachi panel(DX11D100VM) which is using Renesas R69328 Driver IC

config LUT_FILE_TUNING
    tristate "Display Sub System Look-up-table Tuning"
    default n
    help
        This is Display Sub System Look-up-table Tuning

## LGE_SJIT_E 2011-08-29 [choongryeol.lee@lge.com]
endmenu
```

## drivers/video/omap2/dsscomp/Kconfig
```kconfig
menuconfig DSSCOMP
        tristate "OMAP DSS Composition support (EXPERIMENTAL)"
        depends on OMAP2_DSS
	default y

        help
          Frame composition driver using OMAP DSS2.  Allows using all
	  DSS2 resources in a unified configuration.  Should not be used
	  together with other DSS2 devices, such as V4L2 or framebuffer.

config DSSCOMP_DEBUG_LOG
	bool "Log event timestamps in debugfs"
	default y
	depends on DEBUG_FS

	help
	  Takes timestamp for each callback and state transition, and
	  logs the last 128 entries (last few frames' worth) in a
	  log buffer.  This is a separate menuconfig in case this is
	  deemed an overhead.

config DSSCOMP_ADAPT
	bool "DSSCOMP Adaptation(EXPERIMENTAL)"
	default n
	depends on DSSCOMP

	help
		When input of layer is not compatible with display,
		DSSCOMP_ADAPT will do adaptation processing.

config DSSCOMP_COPY_FOR_ROT
	bool "Rotation Support for Non 2D Tiler buffer in DSSCOMP (EXPERIMENTAL)"
	default n
	depends on DSSCOMP

	help
		When non 2D tiler buffer needs rotation, this will allocate 
		2D tiler buffer and copy buffer to allocated 2D tiler buffer.
		Using this feature, PVR will draw to VRAM.
```
