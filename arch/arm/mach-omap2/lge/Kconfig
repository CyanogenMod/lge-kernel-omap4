## arch/arm/mach-omap2/lge/Kconfig
```kconfig
if ARCH_OMAP

menuconfig MACH_LGE
	bool "LGE board select"
	depends on ARCH_OMAP4 || ARCH_OMAP3
	help 
		Select LGE board for which you want to make kernel image.

if MACH_LGE
source "arch/arm/mach-omap2/lge/Kconfig.board"
endif

choice
        prompt "Choose LPDDR2 Size"
        depends on MACH_LGE_IFF || MACH_LGE_P2 || MACH_LGE_U2
        default MACH_LGE_LPDDR2_1GB

config MACH_LGE_LPDDR2_1GB
        bool "LPDDR2 1GB"

config MACH_LGE_LPDDR2_512MB
        bool "LPDDR2 512MB"

endchoice

menu "LGE Workarounds for OMAP bugs"
	depends on ARCH_OMAP4 || ARCH_OMAP3

config LGE_WORKAROUND_PWRBUTTON
	bool "workaround for a bug that power button irq handler reports wrong state"
	default n
	help
	  This problem has reported in Cosmo project.
	  The normal behavior of the button is compsed of press and release in pairs.
	  But sometimes, the button reports only release state.
	  This workaround maintains previous power button status to detect problem.

	  Say 'Y' if you want to use this workaround

config LGE_WORKAROUND_PWRBUTTON_BATLOW
	bool "workaround for powerbutton on low battery"
	default n
	help
	  Wait-on state if VAT < VBATMIN_HI.
	  In this state, power button is not working.
	  So, set the VBATMIN_HI's value lower to exit Wait-on state

	  Say 'Y' if you want to use this workaround

config LGE_WORKAROUND_IGNORE_WAKEUP_GPIOS
	bool "Ignore wakeup gpios"
	default n
	help
	  Omap has some problem of gpio interrupt lost in offmode.
	  So omap-gpio use the I/O pad wakeup as workaround for that bug.
	  However it has side effect that by enabling it causes spurious
	  wakeup events when system is in offmode.

	  This is for ignoring I/O pad wakeup which is not intended to wakeup
	  the system

	  Say 'Y' if you want to use this workaround
endmenu

## LGE_SJIT_S 09/28/2011 [mohamed.khadri@lge.com] Enabled Bluetooth Related configuration
comment "BCM4330 BT Configuration"
        depends on LBEE9QMB_RFKILL

config BRCM_LPM
       bool "BRCM LPM - Low Power Mode"
       default y

config BRCM_HOST_WAKE
       bool "BT BRCM Host Wakeup"
       default y
       depends on BRCM_LPM

config BRCM_BT_WAKE
       bool "BRCM BT Wakeup"
       default y
       depends on BRCM_LPM
## LGE_SJIT_E 09/28/2011 [mohamed.khadri@lge.com] Enabled Bluetooth Related configuration

config OMAP_UART4_EARLY_PRINTK
       bool "OMAP UART4 EARLY PRINTK for INIT DEBUG"
       default n

config LGE_HANDLE_PANIC
	tristate "Support LGE Kernel Panic Handler"
	default n
	depends on MACH_LGE
	depends on ANDROID_RAM_CONSOLE
	help
	  LGE crash handler

config LGE_SUSPEND_AUTOTEST
	tristate "Test suspend/resume and earlysuspend/lateresume automatically"
	default n
	depends on MACH_LGE && SUSPEND && EARLYSUSPEND
	help
	  This option will let you suspend your machine, and make it wake up
	  a few seconds later using an timer automatically.
	  Enable this with a kernel parameter by sysfs.
endif
```

## arch/arm/mach-omap2/lge/Kconfig.board
```kconfig
#
# Include the specific Kconfig file for the different LGE board
#
source "arch/arm/mach-omap2/lge/iff/Kconfig"
source "arch/arm/mach-omap2/lge/p2/Kconfig"
source "arch/arm/mach-omap2/lge/u2/Kconfig"
source "arch/arm/mach-omap2/lge/lghdk/Kconfig"
source "arch/arm/mach-omap2/lge/cosmo/Kconfig"
```

## arch/arm/mach-omap2/lge/cosmo/Kconfig
```kconfig
#
# LGE P940
#

config MACH_LGE_COSMO
	bool "LGE COSMO board"
	select HIGHMEM
	select TWL6030_PWM
	select TWL6030_GPADC
	select MISC_DEVICES
	select STAGING
	select IIO
	select HWMON
	select INPUT_MISC
	select INPUT_KEYBOARD
	select INPUT_TOUCHSCREEN
	select POWER_SUPPLY
	select TWL6030_BCI_BATTERY
#	select SECURITY_MIDDLEWARE_COMPONENT
	select CDC_TCXO
	select INPUT_TWL6030_PWRBUTTON
	select OMAP_REBOOT_REASON

config INPUT_LGE_ANDROID_3KEYS
	bool "LGE COSMO Android 3kyes for korea domestic board"
	depends on MACH_LGE_COSMO

config MACH_LGE_COSMO_P920
	bool "LGE COSMO P920 board"
	depends on MACH_LGE_COSMO
	default y

config MACH_LGE_COSMO_SU760
	bool "LGE COSMO SU760 board"
	depends on MACH_LGE_COSMO

config MACH_LGE_COSMO_3D_DISPLAY
	bool "LGE COSMO SU760 board"
	depends on MACH_LGE_COSMO
	default y
config COSMO_ICS_MEM_OPT
	bool "LGE COSMO SU760 board"
	depends on MACH_LGE_COSMO
	default y

config GPS
       bool "GPS GPIO driver"
       default n
       help
         This is a driver to control GPS by GPIO.

config P940_GPS_LNA_SD_USE
       bool "GPS extend LNA GPIO support"
       depends on GPS
       default n
       help
         If you want to support GPS extend LNA GPIO, say Y.
```

## arch/arm/mach-omap2/lge/cx2/Kconfig
```kconfig
#
# LGE CX2
#

config MACH_LGE_CX2
	bool "LGE CX2 board"
	select HIGHMEM
	select TWL6030_PWM
	select TWL6030_GPADC
	select MISC_DEVICES
	select STAGING
	select IIO
	select HWMON
	select INPUT_MISC
	select INPUT_KEYBOARD
	select INPUT_TOUCHSCREEN
	select POWER_SUPPLY
	select TWL6030_BCI_BATTERY
	select SECURITY_MIDDLEWARE_COMPONENT
	select CDC_TCXO
	select INPUT_TWL6030_PWRBUTTON
	select OMAP_REBOOT_REASON

config INPUT_LGE_ANDROID_3KEYS
	bool "LGE CX2 Android 3kyes for korea domestic board"
	depends on MACH_LGE_CX2

config MACH_LGE_CX2_P720
	bool "LGE CX2 P720 board"
	depends on MACH_LGE_CX2
	default y

config MACH_LGE_CX2_SU870
	bool "LGE CX2 SU870 board"
	depends on MACH_LGE_CX2
	default y

config MACH_LGE_CX2_3D_DISPLAY
	bool "LGE CX2 SU870 board"
	depends on MACH_LGE_CX2
	default y
```

## arch/arm/mach-omap2/lge/iff/Kconfig
```kconfig
#
# LGE IFF
#

config MACH_LGE_IFF
	bool "LGE IFF board"
	select TWL6030_GPADC
#	select LEDS_OMAP4430_SDP_DISPLAY
#	select LEDS_OMAP4430_SDP_KEYPAD
#	select SENSORS_LM75
#	select INPUT_BH1780
#	select INPUT_BMP085
#	select INPUT_HMC5843
#	select INPUT_SFH7741
	select INPUT_MISC
	select HWMON
#	select INPUT_CMA3000
#	select INPUT_CMA3000_I2C
	select OMAP_PACKAGE_CBL
	select OMAP_PACKAGE_CBS
	select REGULATOR_FIXED_VOLTAGE
	select OMAP_TPS6236X
#	select TOUCHSCREEN_SYNTM12XX
	select TWL6030_POWEROFF
	select INPUT_TWL6030_PWRBUTTON
	select OMAP_REBOOT_REASON
```

## arch/arm/mach-omap2/lge/p2/Kconfig
```kconfig
#
# LGE P940
#

config MACH_LGE_P2
	bool "LGE P2 board"
	select HIGHMEM
	select TWL6030_PWM
	select TWL6030_GPADC
	select MISC_DEVICES
	select STAGING
	select IIO
	select HWMON
	select INPUT_MISC
	select INPUT_KEYBOARD
	select INPUT_TOUCHSCREEN
	select POWER_SUPPLY
	select TWL6030_BCI_BATTERY
	select SECURITY_MIDDLEWARE_COMPONENT
	select CDC_TCXO
	select INPUT_TWL6030_PWRBUTTON
	select OMAP_REBOOT_REASON

config INPUT_LGE_ANDROID_3KEYS
	bool "LGE P2 Android 3kyes for korea domestic board"
	depends on MACH_LGE_P2

config MACH_LGE_P2_P940
	bool "LGE P2 P940 board"
	depends on MACH_LGE_P2
	default y

config MACH_LGE_P2_SU540
	bool "LGE P2 SU540 board"
	depends on MACH_LGE_P2

config MACH_LGE_P2_KU5400
	bool "LGE P2 KU5400 board"
	depends on MACH_LGE_P2

config MACH_LGE_P2_LU5400
	bool "LGE P2 LU5400 board"
	depends on MACH_LGE_P2

config MACH_LGE_P2_DCM
	bool "LGE P2 DCM board"
	depends on MACH_LGE_P2
```

## arch/arm/mach-omap2/lge/u2/Kconfig
```kconfig
#
# LGE U2
#

config MACH_LGE_U2
	bool "LGE U2 board"
	select HIGHMEM
	select TWL6030_PWM
	select TWL6030_GPADC
	select MISC_DEVICES
	select STAGING
	select IIO
	select HWMON
	select INPUT_MISC
	select INPUT_KEYBOARD
	select INPUT_TOUCHSCREEN
	select POWER_SUPPLY
	select TWL6030_BCI_BATTERY
	select SECURITY_MIDDLEWARE_COMPONENT
	select CDC_TCXO
	select INPUT_TWL6030_PWRBUTTON
	select OMAP_REBOOT_REASON

config INPUT_LGE_ANDROID_3KEYS
	bool "LGE U2 Android 3kyes for korea domestic board"
	depends on MACH_LGE_U2

config MACH_LGE_U2_P760
	bool "LGE U2 P760 board"
	depends on MACH_LGE_U2

config MACH_LGE_U2_P769
	bool "LGE U2 P769 board"
	depends on MACH_LGE_U2

config MACH_LGE_U2_P768
	bool "LGE U2 P768 board"
	depends on MACH_LGE_U2	
```

## drivers/broadcast/Kconfig
```kconfig
# LGE Broadcast Device Driver Support

menu "LGE Broadcast Device Support"


config LGE_BROADCAST_1SEG
	bool "1Seg Broadcast service"
	depends on MACH_LGE_P2_DCM
	default y
	help
	  Select this if you want to use Japanese 1Seg mobile broadcast service


config LGE_BROADCAST_TDMB
	bool "LGE broadcast TDMB device Driver"
	depends on MACH_LGE_P2_SU540 || MACH_LGE_P2_KU5400 || MACH_LGE_P2_LU5400 || MACH_LGE_COSMO_SU760
	default y
	help
	  Select this if you want to use TDMB broadcast service

config LGE_BROADCAST_TDMB
	bool "LGE broadcast TDMB device Driver"
	depends on MACH_MSM8960_LX_KR
	default y
	help
	  Select this if you want to use TDMB broadcast service

source "drivers/broadcast/oneseg/Kconfig"
source "drivers/broadcast/tdmb/Kconfig"
endmenu
```

## drivers/broadcast/oneseg/Kconfig
```kconfig
#
# 1Seg Broadcast Device Driver Support
#

#menu "1SEG_BROADCAST_DEVICE"

config LGE_BROADCAST_ISDBT_MTV250
	bool "1Seg broacast tuner chipset MTV250 device driver"
	default y
	depends on LGE_BROADCAST_1SEG
	help
	  Select this if you want to use Japanese 1Seg mobile broadcast service

source "drivers/broadcast/oneseg/raon_mtv250/Kconfig"
#endmenu
```

## drivers/broadcast/tdmb/Kconfig
```kconfig
#menu "BROADCAST_DEVICE"

#
# Broadcast Device Driver Support
#

#menu "BROADCAST_DEVICE"

config LGE_BROADCAST_TDMB_FC8050
	bool "LGE broacast TDMB FC8050 device"
	depends on LGE_BROADCAST_TDMB && MACH_LGE_COSMO_SU760
	default y
	help
	  Select this if you want to use broadcast service
	  
#config LGE_BROADCAST_TDMB_LG2102
#	bool "LGE broacast TDMB LG2102 device"
#	depends on LGE_BROADCAST_TDMB
#	default n
#	help
#	  Select this if you want to use broadcast service
	  
config LGE_BROADCAST_TDMB_T3900
	bool "LGE broacast TDMB T3900 device"
	depends on LGE_BROADCAST_TDMB && (MACH_LGE_P2_SU540 || MACH_LGE_P2_KU5400 || MACH_LGE_P2_LU5400)
	default y
	help
	  Select this if you want to use broadcast service	  	  

config LGE_BROADCAST_TDMB_T39FX
	bool "LGE broacast TDMB T39FX device"
	depends on LGE_BROADCAST_TDMB && MACH_MSM8960_LX_KR
	default y
	help
	  Select this if you want to use broadcast service	  	  
#endmenu
```

## drivers/broadcast/tdmb/t39fx/src/Kconfig
```kconfig
#
# T39FX_DEVICE subsystem configuration
#

#menu "T39FX support"

config T39FX_TDMB
	default n
	---help---
	  This driver implements the front-end of the Xen virtual
	  keyboard and mouse device driver.  It communicates with a back-end
	  in another domain.
  
#endmenu
```

## drivers/broadcast/tdmb/tcc3170/Kconfig
```kconfig
#
# TELECHIPS TCC3170 DEVICE subsystem configuration
#

#menu "TCC3170 support"

config TCC3170_TDMB
	default n
	---help---
	  This driver implements the front-end of the Xen virtual
	  keyboard and mouse device driver.  It communicates with a back-end
	  in another domain.
  
#endmenu
```

## drivers/broadcast/tdmb/tcc3170/src/Kconfig
```kconfig
#
# TCC3170 DEVICE subsystem configuration
#

#menu "TCC3170 support"

config TCC3170_TDMB
	default n
	---help---
	  This driver implements the front-end of the Telechips virtual
	  DMB Tuner and BB device driver.  It communicates with a back-end
	  in another domain.
  
#endmenu
```

## drivers/felica/Kconfig
```kconfig
#platform.team@lge.com	2011.01

comment "LGE Felica selection"

config LGE_FELICA
	bool "Felica driver"
	default n
	---help---
	LGE Felica related change	
```

## drivers/lg_nvdata/Kconfig
```kconfig
menuconfig LG_NVDATA
	bool "lg nv data interface"
	help
	  no help...

if LG_NVDATA


config LG_NVDATA_KOBJECT
	tristate "lg_nvdata interface...."
	help
	  no help...

endif # LG_NVDATA
```

## drivers/lge/Kconfig
```kconfig
# drivers/lge/Kconfig

menuconfig LGE_DRIVERS
	bool "LGE Drivers"
	depends on MACH_LGE
	default y
	help
	  Support for LG specific drivers.

if LGE_DRIVERS
source "drivers/lge/fuelgauge/Kconfig"
source "drivers/lge/subpmic/Kconfig"
source "drivers/lge/misc/Kconfig"
source "drivers/lge/mtc_eta/Kconfig"
source "drivers/lge/mhl/Kconfig"
source "drivers/lge/gps/Kconfig"
endif
```

## drivers/lge/fuelgauge/Kconfig
```kconfig
config LG_FW_MAX17043_FUEL_GAUGE
	bool "MAX17043_FUEL_GAUGE"
	default n
	help
	  Support for MAX17043_FUEL_GAUGE driver.

choice
	prompt "Choose the LG_FW_MAX17043_FUEL_GAUGE BUS"
	depends on LG_FW_MAX17043_FUEL_GAUGE
	default LG_FW_MAX17043_FUEL_GAUGE_GPIO

config LG_FW_MAX17043_FUEL_GAUGE_I2C
	bool "MAX17043_FUEL_GAUGE_I2C"
	depends on LG_FW_MAX17043_FUEL_GAUGE
	help
	  Support for MAX17043_FUEL_GAUGE I2C  driver.

config LG_FW_MAX17043_FUEL_GAUGE_GPIO
	bool "MAX17043_FUEL_GAUGE_GPIO"
	depends on LG_FW_MAX17043_FUEL_GAUGE
	help
	  Support for MAX17043_FUEL_GAUGE GPIO driver.
endchoice

config LG_FW_STC3105_FUEL_GAUGE
	bool "STC3105_FUEL_GAUGE"
	default n
	help
	  Support for STC3105_FUEL_GAUGE driver.

config LG_FW_MAX17048_FUEL_GAUGE
	bool "MAX17048_FUEL_GAUGE"
	depends on I2C
	help
	  Support for MAX17048_FUEL_GAUGE driver.

config LG_FW_MAX17048_FUEL_GAUGE_I2C
	tristate "MAX17048_FUEL_GAUGE_I2C"
	depends on I2C
	select LG_FW_MAX17048_FUEL_GAUGE
	help
	  Support for MAX17048_FUEL_GAUGE driver.
```

## drivers/lge/gps/Kconfig
```kconfig
config GPS
	bool "GPS GPIO driver"
	default n
	help
	  This is a driver to control GPS by GPIO.

config P940_GPS_LNA_SD_USE
	bool "GPS extend LNA GPIO support"
	depends on GPS
	default n
	help
	  If you want to support GPS extend LNA GPIO, say Y.
```

## drivers/lge/mhl/Kconfig
```kconfig
config MHL
	bool "MHL driver"
	default n
	help
	  Support for MHL driver.

config MHL_TX_SII9244
	bool "SII9244 MHL TX"
	default n
	depends on MHL
	help
	  Support for SII9244 MHL driver.
	  This driver is came from GED device.
		
config MHL_TX_SII9244_LEGACY
	bool "SII9244 MHL TX Legacy"
	default n
	depends on MHL
	help
	  Support for SII9244 MHL Legacy driver
	  This driver was used in P2 GB version.

config MHL_LG_MOTION_CTL
	bool "Use input event for LGE Motion remocon"
	default n
	depends on MHL_TX_SII9244_LEGACY
	help
	  Support for LGE Motion remocon.

config MHL_TX_MUIC_BUG_FIX
	bool "TSU5611 MUIC bug fix for MHL"
	default n
	depends on MHL_TX_SII9244 || MHL_TX_SII9244_LEGACY
	help
	  TSU5611 300ms delay side effect bug fixed

config SII9244_HDCP
	bool "SII9244 HDCP"
	default n
	depends on MHL_TX_SII9244_LEGACY
	help
	  Support for SII9244 MHL driver and HDCP.

config MHL_INPUT_RCP
	bool "Use input event for MHL RCP"
	default n
	depends on MHL_TX_SII9244_LEGACY
	help
	  Use input event for MHL RCP
```
