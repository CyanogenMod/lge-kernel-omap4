## drivers/lge/misc/Kconfig
```kconfig
config LGE_VIBRATOR
	bool "OMAP PWM Vibrator"
	default n
	help
	  Vibrator driver with OMAP-PWM

config SENSORS_APDS9900
	bool "Avago APDS9900 sensor"
	default n
    depends on MACH_LGE_P2 || MACH_LGE_COSMO
	help
	  If you say Y here you get support for the Avago APDS9900
	  ambient light + proximity sensor.

config SENSORS_APDS9190
	bool "Avago APDS9190 sensor"
	default n
    depends on MACH_LGE_U2
	help
	  If you say Y here you get support for the Avago APDS9190
	  proximity sensor.

config BACKLIGHT_LM3528
	bool "Backlight Driver for LM3528"
	depends on BACKLIGHT_CLASS_DEVICE
	select SUBPMIC_LM3528
	help
	  If you have a LCD backlight connected to the MAIN and(or)
	  SUB/FB output of LM3528, say Y here to enable this driver.
	  To compile this driver as a module, choose M here: the module
	  will be called lm3528_bl

config BACKLIGHT_LM3530
	bool "Backlight Driver for LM3530"
	depends on BACKLIGHT_CLASS_DEVICE
	select SUBPMIC_LM3530
	help
	  If you have a LCD backlight connected to the MAIN and(or)
	  SUB/FB output of LM3530, say Y here to enable this driver.
	  To compile this driver as a module, choose M here: the module
	  will be called lm3530_bl

config BACKLIGHT_LM3533
	bool "Backlight Driver for LM3530"
	depends on BACKLIGHT_CLASS_DEVICE
	select SUBPMIC_LM3533
	help
	  If you have a LCD backlight connected to the MAIN and(or)
	  SUB/FB output of LM3533, say Y here to enable this driver.
	  To compile this driver as a module, choose M here: the module
	  will be called lm3533_bl

config CAMERAFLASH_LM3559
	bool "Camera flash driver for LM3559"
	default n
	help
	  This is a camera flash driver for LM3559

config KEYPAD_LEDS_GPIO
	bool "Keypad led driver controlled by GPIO"
	select NEW_LEDS
	select LEDS_CLASS
	help
	  If you say Y here get driver support for the keypad backlight
	  controlled by GPIO

config LGE_GPIO_CONTROL
	bool "GPIO control support"
	default n
	help
	  If you want to change GPIO control, say Y
```

## drivers/lge/mtc_eta/Kconfig
```kconfig
config LGE_MTC_ETA
      bool "Support LGE MTC_ETA Event (Key, Touch) Logging"
      default n
      depends on MACH_LGE
      help
         LGE MTC/ETA
```

## drivers/lge/subpmic/Kconfig
```kconfig
# drivers/lge/Kconfig

config SUBPMIC_AAT2862
	bool "Backlight driver for AAT2862 using OLED"
	default n
	help
	  If you have a LCD backlight connected to the MAIN and(or)
	  SUB/FB output of AAT2862, say Y here to enable this driver.
	  To Compile this driver as a module, choose M here: the module
	  will be called aat2862_bl.

config SUBPMIC_LM3528
	bool "Backlight driver for LM3528 using OLED"
	default n
	help
	  If you have a LCD backlight connected to the MAIN and(or)
	  SUB/FB output of LM3528, say Y here to enable this driver.
	  To Compile this driver as a module, choose M here: the module
	  will be called lm3528_bl.

config SUBPMIC_LM3530
	bool "Backlight driver for LM3530 using OLED"
	default n
	help
	  If you have a LCD backlight connected to the MAIN and(or)
	  SUB/FB output of LM3530, say Y here to enable this driver.
	  To Compile this driver as a module, choose M here: the module
	  will be called lm3530_bl.

config SUBPMIC_LM3533
	bool "Backlight driver for LM3533 using OLED"
	default n
	help
	  If you have a LCD backlight connected to the MAIN and(or)
	  SUB/FB output of LM3533, say Y here to enable this driver.
	  To Compile this driver as a module, choose M here: the module
	  will be called lm3533_bl.

config SUBPMIC_RT8053
	bool "SUB PMIC RT8053"
	default n
	help
	  Support for RT8053 SUB PMIC driver.

config SUBPMIC_LP8720
	bool "SUB PMIC LP8720"
	default n
	help
	  Support for LP8720 SUB PMIC driver.
```

## drivers/misc/bmc050/Kconfig
```kconfig
config SENSORS_BMA250
	tristate "BMA250 Acceleration Sensor Driver"
	depends on I2C && MACH_LGE_U2
	help
	 BMA250 Acceleration Sensor Driver implemented by Bosch-Sensortec.

config SENSORS_BMM050
	tristate "BMM050 Magnetic Sensor Driver"
	depends on I2C && MACH_LGE_U2
	help
	 BMM050 Magnetic Sensor Driver implemented by Bosch-Sensortec.

config SENSORS_BMC050
    bool "BMC050 Accel. & Magnetic Sensor Driver"
	depends on SENSORS_BMA250 && SENSORS_BMM050
    default y
	help
	 BMC050 Accel. & Magnetic Sensor Driver implemented by Bosch-Sensortec.
```

## drivers/misc/mpu3050/Kconfig
```kconfig
menu "Motion Sensors Support"

config MPU_SENSORS_MPU3050
    bool "MPU3050"
    depends on I2C && (MACH_LGE_P2 || MACH_LGE_COSMO)
    help
      If you say yes here you get support for the MPU3050 Gyroscope driver
      This driver can also be built as a module.  If so, the module
      will be called mpu3050.

config MPU_SENSORS_KXTF9
    bool "Kionix KXTF9"
    depends on MPU_SENSORS_MPU3050
    help
      This enables support for the Kionix KXFT9 accelerometer

config MPU_SENSORS_AMI30X
    bool "Aichi Steel ami30X"
    depends on MPU_SENSORS_MPU3050
    help
      This enables support for the Aichi Steel ami304/ami305 compass

config MPU_SENSORS_TIMERIRQ
    tristate "Timer IRQ"
    depends on MACH_LGE_P2 || MACH_LGE_COSMO 
    help
      If you say yes here you get access to the timerirq device handle which
      can be used to select on.  This can be used instead of IRQ's, sleeping,
      or timer threads.  Reading from this device returns the same type of
      information as reading from the MPU and slave IRQ's.

config MPU_SENSORS_DEBUG
    bool "MPU debug"
    depends on MPU_SENSORS_MPU3050 || MPU_SENSORS_MPU6000 || MPU_SENSORS_TIMERIRQ
    help
      If you say yes here you get extra debug messages from the MPU3050
      and other slave sensors.

endmenu
```

## drivers/misc/ts0710mux/Kconfig
```kconfig
config TS0710_MUX
	bool "TS0710 multiplexer"
	default n 
	help
	  Say 'Y' to enable TS0710 multiplexer

config LGE_KERNEL_MUX
	bool "LGE KERNEL MUX"
	default y if TS0710_MUX
	help
	  Say 'Y' to enable LGE KERNEL MUX (?)
```
